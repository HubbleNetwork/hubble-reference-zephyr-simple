## west.yml
```yaml
# Copyright (c) 2024 HubbleNetwork
# SPDX-License-Identifier: Apache-2.0

manifest:

  remotes:
    - name: zephyrproject-rtos
      url-base: https://github.com/zephyrproject-rtos
    - name: hubble
      url-base: https://github.com/HubbleNetwork

  projects:
    - name: zephyr
      remote: zephyrproject-rtos
      revision: main
      import: true
      west-commands: scripts/west-commands.yml
    - name: hubble-device-sdk
      repo-path: hubble-device-sdk
      revision: v1.0.0
      path: modules/lib/hubble-device-sdk
      remote: hubble
```
